#define LOG_OUT 1 // use the log output function
#define FFT_N 256 // set to 256 point fft

#include <FFT.h> // include the library
#include <avr/io.h>
#include <avr/interrupt.h>
#include "talkie.h"

const int inputPin = 2; 
const int ledPin = 5;

long startTime = 0;

/* 안녕하세요. */
const uint8_t hello[] PROGMEM = {0x00,0xAE,0x4A,0xD5,0xD8,0x53,0xA9,0x2E,0x2B,0x55,0x93,0x2A,0xA5,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0xC0,0xFF};
/* 안녕하세요. 강형원님. */
const uint8_t khw[] PROGMEM = {0x00,0x00,0x00,0xA1,0x08,0x9E,0xD9,0xD4,0xE5,0xAD,0x22,0x44,0x55,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0xF0,0xFF};
/* 안녕하세요. 김가연님. */
const uint8_t kgy[] PROGMEM = {0x00,0x00,0x00,0x5C,0xC2,0x71,0xEF,0x2A,0x0B,0x49,0x29,0x88,0xDB,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0x00,0xFF};
/* 안녕하세요. 이전우님. */
const uint8_t ljw[] PROGMEM = {0x00,0x00,0x44,0x03,0xF3,0x13,0x98,0xB4,0x2B,0x0D,0x8C,0x2F,0x64,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0xE0,0xFF};
/* 안녕하세요. 전한별님. */
const uint8_t jhb[] PROGMEM = {0x00,0x00,0x00,0x26,0x1A,0xD0,0x5C,0x45,0x83,0xB4,0x4C,0xB8,0x12,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0xC0,0xFF};
/* 안녕하세요. 정기평님. */
const uint8_t jkp[] PROGMEM = {0x00,0x00,0x00,0x29,0xE3,0xB2,0x55,0x32,0xCC,0xAC,0xCC,0xEB,0x32,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0xC0,0xFF};
/* 안녕하세요. 정종우님. */
const uint8_t jjw[] PROGMEM = {0x00,0x00,0x00,0x29,0x63,0x62,0x4D,0xCA,0xCD,0x8C,0x4C,0xD9,0x36,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0x00,0xFF};

Talkie voice;

void setup() {
  Serial.begin(115200); // use the serial port
  ADCSRA = 0xe5; // set the adc to free running mode
  ADMUX = 0x40; // use adc0
  DIDR0 = 0x01; // turn off the digital input for adc0
  pinMode(inputPin, INPUT_PULLUP);
  pinMode(ledPin, OUTPUT);
}

void loop() {
  
  if (digitalRead(inputPin)==LOW){
    startTime = millis();
    digitalWrite(ledPin,HIGH);
    
    while (millis()-startTime<=1000){
       // reduces jitter
      cli();  // UDRE interrupt slows this way down on arduino1.0
      for (int i = 0 ; i < 512 ; i += 2) { // save 256 samples
        while(!(ADCSRA & 0x10)); // wait for adc to be ready
        ADCSRA = 0xf5; // restart adc
        byte m = ADCL; // fetch adc data
        byte j = ADCH;
        int k = (j << 8) | m; // form into an int
        k -= 0x0200; // form into a signed int
        k <<= 6; // form into a 16b signed int
        fft_input[i] = k; // put real data into even bins
        fft_input[i+1] = 0; // set odd bins to 0
      }
      fft_window(); // window the data for better frequency response
      fft_reorder(); // reorder the data before doing the fft
      fft_run(); // process the data in the fft
      fft_mag_log(); // take the output of the fft
      sei();
      
      for (int i=0; i < FFT_N/2; i++){
        Serial.print(fft_log_out[i]);
        if (i!=FFT_N/2 - 1) Serial.print(',');
      }
      
      Serial.print("\n");

    }
    digitalWrite(ledPin,LOW);

  }
  else{
    digitalWrite(ledPin,LOW);
  }

  if(Serial.available()>0)
  {
    int value = Serial.parseInt();
    voice.say(hello);
    
    switch(value)
    {
      case 0: 
        voice.say(khw);
        break;
      case 1: 
       voice.say(kgy);
        break;
      case 2: 
        voice.say(ljw);
        break;
      case 3: 
        voice.say(jhb);
        break;
      case 4: 
        voice.say(jkp);
        break;
      case 5: 
        voice.say(jjw);
        break;
    }

  }  
  
}
